## CMakeLists.txt
```
# Copyright (c) 2023 Intel Corporation Inc.
#
# SPDX-License-Identifier: Apache-2.0
#

cmake_minimum_required(VERSION 3.20.0)

find_package(Zephyr REQUIRED HINTS $ENV{ZEPHYR_BASE})
project(iut_test)

zephyr_linker_sources(RODATA custom-sections.ld)
zephyr_cc_option(-Werror)

target_include_directories(app PRIVATE ./include)

target_sources(app PRIVATE src/main.c src/shell_iut.c)

#target_sources(app PRIVATE src/test_example.c)
add_subdirectory(test_sedi)
add_subdirectory(test_zephyr)
```

## prj.conf
```kconfig
#
# Copyright (c) 2023 Intel Corporation.
#
# SPDX-License-Identifier: Apache-2.0
#

CONFIG_MAIN_THREAD_PRIORITY=14

# basic
CONFIG_BOOT_BANNER=y

# shell
CONFIG_SHELL=y
CONFIG_KERNEL_SHELL=y
CONFIG_DEVICE_SHELL=y
CONFIG_THREAD_NAME=y
CONFIG_INIT_STACKS=y
CONFIG_THREAD_STACK_INFO=y
CONFIG_THREAD_MONITOR=y
CONFIG_SHELL_THREAD_PRIORITY_OVERRIDE=y
CONFIG_SHELL_THREAD_PRIORITY=13

# debug
#CONFIG_NO_OPTIMIZATIONS=y
CONFIG_X86_DEBUG_INFO=y
CONFIG_EXCEPTION_STACK_TRACE=y
CONFIG_OUTPUT_DISASSEMBLY=y
CONFIG_ASSERT=y

# logging
CONFIG_LOG=y
CONFIG_LOG_PRINTK=y
CONFIG_LOG_BACKEND_I2C=y
CONFIG_LOG_PROCESS_TRIGGER_THRESHOLD=1

# DMA
CONFIG_DMA=y

# I2C
CONFIG_I2C=y
CONFIG_I2C_SHELL=y

# GPIO
CONFIG_GPIO=y

# SPI
CONFIG_SPI=y

# IPC/IPM
CONFIG_IPM=y

CONFIG_PM=y
CONFIG_SHELL_BACKEND_SERIAL_INTERRUPT_DRIVEN=n
CONFIG_SHELL_BACKEND_SERIAL_RX_POLL_PERIOD=1
CONFIG_PM_DEVICE_SHELL=y

CONFIG_IDLE_STACK_SIZE=4096
CONFIG_SYSTEM_WORKQUEUE_STACK_SIZE=4096
CONFIG_MAIN_STACK_SIZE=4096
CONFIG_SHELL_STACK_SIZE=4096
```

## app.overlay
```dts
/ {
	chosen {
		zephyr.log-i2c=&i2c0;
	};
};

&cpu0 {
	cpu-power-states = <&d0i0 &d0i2 &d0i3>;
};

&dma0 {
	status = "okay";
};
```

## src/main.c
```c
/*
 * Copyright (c) 2023 Intel Corporation.
 *
 * SPDX-License-Identifier: Apache-2.0
 */

#include <string.h>
#include <zephyr/kernel.h>
#include "iut.h"
#include <zephyr/sys/__assert.h>

#define ARGC_MIN_NUM 2
#define ARGC_MAX_NUM 8
static char argv_buf[1024];
static uint32_t argv_buf_pos;
static int argc_run;
static char *argv_run[ARGC_MAX_NUM];

static K_SEM_DEFINE(sem_trigger, 1, 1);
static K_SEM_DEFINE(sem_run, 0, 1);

static uint32_t iut_cnt_run;
static uint32_t iut_cnt_fail;

const struct iut_case *iut_running;

static int iut_run(const char *name, const char *group, uint32_t attri,
		int argc, char **argv)
{
	const struct iut_case *ut = NULL;
	int ret;

	iut_print("\nIUT: (%s, %s, 0x%x): Start running cases ......\n",
			group ? group : "NULL", name ? name : "NULL", attri);

	if (argc) {
		iut_print("\targc=%d\n", argc);
		for (int i = 0; i < argc; i++)
			iut_print("\targv[%d]=\"%s\"\n", i, argv[i]);
	}

	iut_cnt_run = iut_cnt_fail = 0;

	while (1) {
		if (ut == NULL) {
			ut = (void *)__iut_cases_start;
		} else {
			ut++;
		}
		if ((char *)ut >= __iut_cases_end) {
			break;
		}

		if (group && strncmp(group, ut->group, strlen(group))) {
			continue;
		}
		if (name && strncmp(ut->name, name, strlen(ut->name) + 1)) {
			continue;
		}
		if (attri && ((ut->attri & attri) != attri)) {
			continue;
		}

		iut_print("IUT: (%s, %s): Case %u, run\n",
				ut->group, ut->name, iut_cnt_run);
		iut_running = ut;

		ret = ut->func(argc, argv);

		iut_print("IUT: (%s, %s): Case %u, %s\n",
				ut->group, ut->name, iut_cnt_run,
				(ret == IUT_ERR_OK) ? "pass" : "fail");
		iut_cnt_run++;
		if (ret != IUT_ERR_OK) {
			iut_cnt_fail++;
		}
	}

	iut_print("\nIUT: (%s, %s, 0x%x): Finished %u cases, %u failed ......\n",
			group ? group : "NULL", name ? name : "NULL", attri,
			iut_cnt_run, iut_cnt_fail);

	return 0;
}

int iut_trigger(size_t argc, char **argv)
{
	if (k_sem_take(&sem_trigger, K_NO_WAIT) != 0) {
		iut_print("busy running (%s: %s: %s), please wait and try later!\n",
				argv_run[0], argv_run[1],
				(argc_run >= 3) ? argv_run[2] : "NULL");
		return -EBUSY;
	}

	if ((argc < ARGC_MIN_NUM) || (argc > ARGC_MAX_NUM)) {
		goto err_out;
	}

	argv_buf_pos = 0;

	for (int i = 0; i < argc; i++) {
		uint32_t len = strlen(argv[i]);

		if ((argv_buf_pos + len + 1) > sizeof(argv_buf)) {
			goto err_out;
		}

		argv_run[i] = &argv_buf[argv_buf_pos];
		memcpy(argv_run[i], argv[i], len + 1);
		argv_buf_pos += (len + 1);
	}

	argc_run = argc;
	k_sem_give(&sem_run);

	return 0;

err_out:
	iut_print("wrong parameters to run, argc=%d", (int)argc);
	return -EPERM;
}

int main(void)
{
	k_msleep(2000);

#ifndef CONFIG_DEBUG
	/* iut_run(NULL, NULL, IUT_ATTRI_AUTORUN, 0, NULL); */
#endif

	while (1) {
		const char *name = NULL;
		const char *group = NULL;

		k_sem_take(&sem_run, K_FOREVER);

		if (strncmp(argv_run[0], "grun", strlen(argv_run[0])) == 0) {
			group = argv_run[1];
		} else {
			__ASSERT_NO_MSG(strncmp(argv_run[0], "run",
						strlen(argv_run[0])) == 0);
			name = argv_run[1];
		}

		iut_run(name, group, 0x0, (argc_run - 2),
				(argc_run - 2) ? (&argv_run[2]) : NULL);

		k_sem_give(&sem_trigger);
		k_sem_give(&sem_trigger);
	};

	return 0;
}
```

## include/iut.h
```c
/*
 * Copyright (c) 2023 Intel Corporation.
 *
 * SPDX-License-Identifier: Apache-2.0
 */

#ifndef _IUT_H_
#define _IUT_H_

#include <stdint.h>

typedef int (*iut_test_func)(int argc, char **argv);

struct iut_case {

	const char *const name;

	const char *const group;

	/* test function to run */
	const iut_test_func func;

	uint32_t attri;
};

#define IUT_ATTRI_NONE    ((uint32_t)0x0)
#define IUT_ATTRI_AUTORUN ((uint32_t)(0x1 << 0))

#define DEFINE_IUT_CASE(_name, _group, _attri) \
	struct iut_case iut_##_name\
			__attribute__((__used__)) \
			__attribute__((__section__(".iut_cases."#_group"."#_name))) = { \
		.name = #_name, \
		.group = #_group, \
		.func = &test_##_name, \
		.attri = _attri, \
	}

extern const char __iut_cases_start[];
extern const char __iut_cases_end[];

#include <zephyr/sys/printk.h>
#define iut_print(fmt, arg...) printk(fmt, ## arg)

extern const struct iut_case *iut_running;

#define iut_case_print(fmt, arg...) \
	iut_print("IUT: (%s, %s): "fmt, iut_running->group, iut_running->name, ## arg)

/* for strtoul */
#include <stdlib.h>

#ifndef ARG_UNUSED
#define ARG_UNUSED(arg) ((void)arg)
#endif

#define IUT_ERR_OK (0)
#define IUT_ERR_ASSERT (-1)

#define TEST_ASSERT_TRUE(_expr) \
	do { \
		if (_expr) \
			break; \
		printk("%s:%d: ASSERT failed\n", __FILE__, __LINE__); \
		return IUT_ERR_ASSERT; \
	} while (0)

#define TEST_ASSERT_EQUAL(_expr1, _expr2) \
		TEST_ASSERT_TRUE((_expr1) == (_expr2))

#define TEST_ASSERT_NOT_EQUAL(_expr1, _expr2) \
		TEST_ASSERT_TRUE((_expr1) != (_expr2))

#endif
```

## include/iut_zephyr.h
```c
/*
 * Copyright (c) 2025 Intel Corporation.
 *
 * SPDX-License-Identifier: Apache-2.0
 */

/* IUT help functions for Zephyr */

#include <zephyr/kernel.h>

#ifndef _IUT_ZEPHYR_H_
#define _IUT_ZEPHYR_H_

#ifndef CONFIG_SHELL_BACKEND_SERIAL_INTERRUPT_DRIVEN
void iut_shell_suspend(void);
void iut_shell_resume(void);
#else
static inline void iut_shell_suspend(void)
{
}

static inline void iut_shell_resume(void)
{
}
#endif

#endif /* _IUT_ZEPHYR_H_ */
```

## src/shell_iut.c
```c
/*
 * Copyright (c) 2023 Intel Corporation.
 *
 * SPDX-License-Identifier: Apache-2.0
 */

#include <zephyr/kernel.h>
#include <zephyr/shell/shell.h>
#include "iut.h"
#include <zephyr/shell/shell_uart.h>

extern int iut_trigger(size_t argc, char **argv);

static int cmd_iut_list(const struct shell *shell,
			      size_t argc, char **argv)
{
	const struct iut_case *ut = (void *)__iut_cases_start;

	ARG_UNUSED(argc);
	ARG_UNUSED(argv);

	shell_fprintf(shell, SHELL_NORMAL, "IUT test cases:\n");
	while ((char *)ut < __iut_cases_end) {
		shell_fprintf(shell, SHELL_NORMAL, "\t- %s, %s, 0x%x\n",
				ut->group, ut->name, ut->attri);
		ut++;
	};

	return 0;
}

static int cmd_iut_run(const struct shell *shell,
			      size_t argc, char **argv)
{
	if (argc < 2)
		return -EPERM;

	return iut_trigger(argc, argv);
}

static int cmd_iut_grun(const struct shell *shell,
			      size_t argc, char **argv)
{
	if (argc < 2)
		return -EPERM;

	return iut_trigger(argc, argv);
}

SHELL_STATIC_SUBCMD_SET_CREATE(sub_iut,
	SHELL_CMD(list, NULL, "List unit cases", cmd_iut_list),
	SHELL_CMD(run, NULL, "run one unit case", cmd_iut_run),
	SHELL_CMD(grun, NULL, "run one group of unit cases", cmd_iut_grun),
	SHELL_SUBCMD_SET_END /* Array terminated. */
);

SHELL_CMD_REGISTER(iut, &sub_iut, "IUT commands", NULL);


#ifndef CONFIG_SHELL_BACKEND_SERIAL_INTERRUPT_DRIVEN
/* The following code could only work when the shell backend is not interrupt-driven. */

static struct shell_uart_polling *sh_uart;

void iut_shell_suspend(void)
{
	if (!sh_uart) {
		/*get current uart shell pointer*/
		const struct shell *shell_ptr = shell_backend_uart_get_ptr();

		if (shell_ptr == NULL) {
			iut_print("get shell pointer error!!!\n");
			return;
		}

		/*get shell uart backend*/
		sh_uart = (struct shell_uart_polling *)shell_ptr->iface->ctx;

		if (sh_uart == NULL) {
			iut_print("get shell UART pointer error!!!\n");
			return;
		}
	}

	k_timer_stop(&sh_uart->rx_timer);
}

void iut_shell_resume(void)
{
	if (sh_uart) {
		k_timer_start(&sh_uart->rx_timer, K_NO_WAIT,
			K_MSEC(CONFIG_SHELL_BACKEND_SERIAL_RX_POLL_PERIOD));
	}
}

#endif
```

## src/test_example.c
```c
/*
 * Copyright (c) 2023 Intel Corporation.
 *
 * SPDX-License-Identifier: Apache-2.0
 */

#include "iut.h"

static int test_example_1(int argc, char **argv)
{
	iut_case_print("argc=%d\n", argc);
	for (int i = 0; i < argc; i++)
		iut_case_print("argv=\"%s\"\n", argv[i]);

	TEST_ASSERT_TRUE(1);

	return IUT_ERR_OK;
}
DEFINE_IUT_CASE(example_1, examples, IUT_ATTRI_AUTORUN);

static int test_example_2(int argc, char **argv)
{
	iut_case_print("argc=%d\n", argc);
	for (int i = 0; i < argc; i++)
		iut_case_print("argv=\"%s\"\n", argv[i]);

	TEST_ASSERT_TRUE(0);
	TEST_ASSERT_TRUE(1);

	return IUT_ERR_OK;
}
DEFINE_IUT_CASE(example_2, examples, IUT_ATTRI_AUTORUN);
```
